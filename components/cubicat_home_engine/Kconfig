## sdkconfig.defaults
```kconfig
CONFIG_IDF_TARGET="esp32s3"
CONFIG_ESPTOOLPY_FLASHSIZE_16MB=y
CONFIG_ESPTOOLPY_FLASHMODE_QIO=y
CONFIG_ESPTOOLPY_FLASHFREQ_80M=y
CONFIG_ESP_DEFAULT_CPU_FREQ_MHZ_240=y

# CONFIG_COMPILER_OPTIMIZATION_SIZE is not set
CONFIG_COMPILER_OPTIMIZATION_PERF=y
CONFIG_COMPILER_CXX_EXCEPTIONS=y
CONFIG_COMPILER_CXX_EXCEPTIONS_EMG_POOL_SIZE=1024
CONFIG_COMPILER_CXX_RTTI=y
CONFIG_BOOTLOADER_COMPILER_OPTIMIZATION_PERF=y
CONFIG_BOOTLOADER_LOG_LEVEL_NONE=y
CONFIG_BOOTLOADER_SKIP_VALIDATE_ALWAYS=y
CONFIG_BOOTLOADER_APP_ROLLBACK_ENABLE=n
CONFIG_BOOTLOADER_VDDSDIO_BOOST_1_9V=y

CONFIG_ESP_MAIN_TASK_STACK_SIZE=16384
CONFIG_ESP_TASK_WDT_TIMEOUT_S=10
CONFIG_ESP_SYSTEM_EVENT_TASK_STACK_SIZE=8192

CONFIG_SPIRAM=y
CONFIG_SPIRAM_MODE_OCT=y
CONFIG_SPIRAM_SPEED_80M=y
CONFIG_SPIRAM_MALLOC_ALWAYSINTERNAL=0
CONFIG_SPIRAM_MALLOC_RESERVE_INTERNAL=98304
CONFIG_SPIRAM_MEMTEST=n
CONFIG_MBEDTLS_EXTERNAL_MEM_ALLOC=y
CONFIG_MBEDTLS_DYNAMIC_BUFFER=y
CONFIG_SPIRAM_USE_MALLOC=y
CONFIG_SPIRAM_TRY_ALLOCATE_WIFI_LWIP=y
CONFIG_SPIRAM_ALLOW_BSS_SEG_EXTERNAL_MEMORY=y

# USB flash-port logs; the board selects console or UVC Host at boot.
CONFIG_ESP_CONSOLE_USB_SERIAL_JTAG=y
CONFIG_USJ_ENABLE_USB_SERIAL_JTAG=y
CONFIG_ESP_CONSOLE_SECONDARY_NONE=y
# CONFIG_ESP_CONSOLE_SECONDARY_USB_SERIAL_JTAG is not set

CONFIG_OPUS_STACK_SIZE=32768

CONFIG_HTTPD_MAX_REQ_HDR_LEN=2048
CONFIG_HTTPD_MAX_URI_LEN=2048
CONFIG_LWIP_TCPIP_RECVMBOX_SIZE=16

CONFIG_ESP_WIFI_IRAM_OPT=n
CONFIG_ESP_WIFI_RX_IRAM_OPT=n
CONFIG_ESP_WIFI_DYNAMIC_RX_MGMT_BUFFER=y
CONFIG_ESP_WIFI_ENTERPRISE_SUPPORT=n
CONFIG_ESP_WIFI_RX_BA_WIN=3

CONFIG_MBEDTLS_SSL_KEEP_PEER_CERTIFICATE=n
CONFIG_MBEDTLS_SSL_RENEGOTIATION=n
CONFIG_LIBC_NEWLIB_NANO_FORMAT=y

CONFIG_PARTITION_TABLE_CUSTOM=y
CONFIG_PARTITION_TABLE_CUSTOM_FILENAME="partitions/v2/16m.csv"
CONFIG_PARTITION_TABLE_OFFSET=0x8000

CONFIG_FLASH_DEFAULT_ASSETS=y
# CONFIG_FLASH_NONE_ASSETS is not set
# CONFIG_FLASH_CUSTOM_ASSETS is not set
CONFIG_SPINE_OTA_ALLOWED_HOSTS="cdn.xiaozhi.me,assets.xiaozhi.me,api.realecho.cn"
CONFIG_SPINE_OTA_ALLOWED_ROLE_IDS="*"
CONFIG_WALLPAPER_OTA_ALLOWED_HOSTS="cdn.xiaozhi.me,assets.xiaozhi.me,api.realecho.cn"
CONFIG_WALLPAPER_OTA_ALLOWED_PACK_IDS="*"

CONFIG_CODEC_I2C_BACKWARD_COMPATIBLE=n
CONFIG_UART_ISR_IN_IRAM=y

CONFIG_ESP32S3_INSTRUCTION_CACHE_32KB=y
CONFIG_ESP32S3_DATA_CACHE_LINE_64B=y

CONFIG_USE_CUSTOM_WAKE_WORD=y
CONFIG_CUSTOM_WAKE_WORD="ni hao xiao nian"
CONFIG_CUSTOM_WAKE_WORD_DISPLAY="你好，小念"
CONFIG_CUSTOM_WAKE_WORD_THRESHOLD=20
CONFIG_SR_MN_CN_MULTINET7_QUANT=y
# CONFIG_AUDIO_WAKE_DIAGNOSTICS is not set
# CONFIG_TASK_DIAGNOSTICS_PERIODIC is not set
# CONFIG_SR_WN_WN9_NIHAOXIAOZHI_TTS is not set

CONFIG_BOARD_TYPE_ESP_BOX_3=y

CONFIG_BT_ENABLED=n
CONFIG_OTA_URL="https://api.realecho.cn/xiaozhi/ota/"


# USB camera: use usb_stream library (incompatible with esp_video UVC)
CONFIG_USE_USB_STREAM=y
# CONFIG_USB_STREAM_QUICK_START is not set
CONFIG_USB_PROC_TASK_PRIORITY=18
CONFIG_USB_PROC_TASK_CORE=1
CONFIG_SAMPLE_PROC_TASK_PRIORITY=17
CONFIG_SAMPLE_PROC_TASK_CORE=1
CONFIG_UVC_GET_DEVICE_DESC=y
CONFIG_UVC_GET_CONFIG_DESC=y
CONFIG_UVC_PRINT_DESC=y
```

## sdkconfig.defaults.esp32s3
```kconfig
CONFIG_IDF_TARGET="esp32s3"
CONFIG_ESPTOOLPY_FLASHSIZE_16MB=y
CONFIG_ESPTOOLPY_FLASHFREQ_80M=y
CONFIG_ESPTOOLPY_FLASHMODE_QIO=y
CONFIG_ESP_DEFAULT_CPU_FREQ_MHZ_240=y
CONFIG_ESP_DEFAULT_CPU_FREQ_MHZ=240
CONFIG_FREERTOS_HZ=1000

# CONFIG_COMPILER_OPTIMIZATION_SIZE is not set
CONFIG_COMPILER_OPTIMIZATION_PERF=y
CONFIG_COMPILER_CXX_EXCEPTIONS=y
CONFIG_COMPILER_CXX_EXCEPTIONS_EMG_POOL_SIZE=1024
CONFIG_COMPILER_CXX_RTTI=y

CONFIG_BOOTLOADER_COMPILER_OPTIMIZATION_PERF=y
CONFIG_BOOTLOADER_LOG_LEVEL_NONE=y
CONFIG_BOOTLOADER_SKIP_VALIDATE_ALWAYS=y
CONFIG_BOOTLOADER_APP_ROLLBACK_ENABLE=n
CONFIG_BOOTLOADER_VDDSDIO_BOOST_1_9V=y

CONFIG_ESP_MAIN_TASK_STACK_SIZE=16384
CONFIG_ESP_TASK_WDT_TIMEOUT_S=10
CONFIG_ESP_SYSTEM_EVENT_TASK_STACK_SIZE=8192
CONFIG_FREERTOS_USE_STATS_FORMATTING_FUNCTIONS=y

# ====================================================
# 3. Memory & PSRAM
# ====================================================
CONFIG_SPIRAM=y
CONFIG_SPIRAM_MODE_OCT=y
CONFIG_SPIRAM_SPEED_80M=y
# 0 = all malloc prefers PSRAM
CONFIG_SPIRAM_MALLOC_ALWAYSINTERNAL=0
# Reserve 96KB internal RAM for DMA (USB Host needs contiguous DMA blocks)
CONFIG_SPIRAM_MALLOC_RESERVE_INTERNAL=98304
CONFIG_SPIRAM_MEMTEST=n
CONFIG_MBEDTLS_EXTERNAL_MEM_ALLOC=y
CONFIG_MBEDTLS_DYNAMIC_BUFFER=y
CONFIG_SPIRAM_USE_MALLOC=y
# WiFi/LWIP buffers prefer PSRAM
CONFIG_SPIRAM_TRY_ALLOCATE_WIFI_LWIP=y
# BSS segment in PSRAM
CONFIG_SPIRAM_ALLOW_BSS_SEG_EXTERNAL_MEMORY=y

# USB flash-port logs; the board selects console or UVC Host at boot.
CONFIG_ESP_CONSOLE_USB_SERIAL_JTAG=y
CONFIG_USJ_ENABLE_USB_SERIAL_JTAG=y
CONFIG_ESP_CONSOLE_SECONDARY_NONE=y
# CONFIG_ESP_CONSOLE_SECONDARY_USB_SERIAL_JTAG is not set

# Opus codec task stack
# 20KB balances first live speech Opus encode headroom with UVC internal DMA memory.
CONFIG_OPUS_STACK_SIZE=32768

# ====================================================
# 4. WiFi & Network
# ====================================================
CONFIG_HTTPD_MAX_REQ_HDR_LEN=2048
CONFIG_HTTPD_MAX_URI_LEN=2048
CONFIG_LWIP_TCPIP_RECVMBOX_SIZE=16

CONFIG_ESP_WIFI_IRAM_OPT=n
CONFIG_ESP_WIFI_RX_IRAM_OPT=n
CONFIG_ESP_WIFI_DYNAMIC_RX_MGMT_BUFFER=y
# Voice+occasional photo scenario: reduce RX/TX buffers to save internal SRAM for USB enumeration
CONFIG_ESP_WIFI_STATIC_RX_BUFFER_NUM=4
CONFIG_ESP_WIFI_DYNAMIC_RX_BUFFER_NUM=6
CONFIG_ESP_WIFI_ENTERPRISE_SUPPORT=n
CONFIG_ESP_WIFI_RX_BA_WIN=3
CONFIG_ESP_WIFI_CACHE_TX_BUFFER_NUM=8

CONFIG_MBEDTLS_SSL_KEEP_PEER_CERTIFICATE=n
CONFIG_MBEDTLS_SSL_RENEGOTIATION=n
CONFIG_LIBC_NEWLIB_NANO_FORMAT=y

# Separate WebSocket TX lock so a slow control send (up to 5s) on the main
# event loop can no longer starve downlink TTS receive, which shares the
# client lock by default.
CONFIG_ESP_WS_CLIENT_SEPARATE_TX_LOCK=y

# ====================================================
# 5. Peripherals & Cache
# ====================================================
CONFIG_PARTITION_TABLE_CUSTOM=y
CONFIG_PARTITION_TABLE_CUSTOM_FILENAME="partitions/v2/16m.csv"
CONFIG_PARTITION_TABLE_OFFSET=0x8000

CONFIG_FLASH_DEFAULT_ASSETS=y
# CONFIG_FLASH_NONE_ASSETS is not set
# CONFIG_FLASH_CUSTOM_ASSETS is not set
CONFIG_SPINE_OTA_ALLOWED_HOSTS="cdn.xiaozhi.me,assets.xiaozhi.me,api.realecho.cn"
CONFIG_SPINE_OTA_ALLOWED_ROLE_IDS="*"
CONFIG_WALLPAPER_OTA_ALLOWED_HOSTS="cdn.xiaozhi.me,assets.xiaozhi.me,api.realecho.cn"
CONFIG_WALLPAPER_OTA_ALLOWED_PACK_IDS="*"

CONFIG_CODEC_I2C_BACKWARD_COMPATIBLE=n
CONFIG_UART_ISR_IN_IRAM=y

CONFIG_ESP32S3_INSTRUCTION_CACHE_32KB=y
CONFIG_ESP32S3_DATA_CACHE_LINE_64B=y

CONFIG_USE_CUSTOM_WAKE_WORD=y
CONFIG_CUSTOM_WAKE_WORD="ni hao xiao nian"
CONFIG_CUSTOM_WAKE_WORD_DISPLAY="你好，小念"
CONFIG_CUSTOM_WAKE_WORD_THRESHOLD=20
CONFIG_SR_MN_CN_MULTINET7_QUANT=y
# CONFIG_AUDIO_WAKE_DIAGNOSTICS is not set
# CONFIG_TASK_DIAGNOSTICS_PERIODIC is not set
# CONFIG_SR_WN_WN9_NIHAOXIAOZHI_TTS is not set

# ====================================================
# 6. Bluetooth DISABLED, use SoftAP provisioning
# ====================================================
CONFIG_BT_ENABLED=n

CONFIG_FREERTOS_GENERATE_RUN_TIME_STATS=y
CONFIG_FREERTOS_USE_TRACE_FACILITY=y
CONFIG_FREERTOS_PLACE_FUNCTIONS_INTO_FLASH=y
CONFIG_FREERTOS_VTASKLIST_INCLUDE_COREID=y



CONFIG_ESP_PROTOCOMM_SUPPORT_SECURITY_VERSION_0=y
CONFIG_ESP_PROTOCOMM_SUPPORT_SECURITY_VERSION_1=y
CONFIG_ESP_PROTOCOMM_SUPPORT_SECURITY_VERSION_2=y

CONFIG_OTA_URL="https://api.realecho.cn/xiaozhi/ota/"

# ====================================================
# LVGL off-screen renderer (minimal config)
# ====================================================
CONFIG_LV_USE_CLIB_MALLOC=y
CONFIG_LV_USE_CLIB_STRING=y
CONFIG_LV_USE_CLIB_SPRINTF=y
CONFIG_LV_OS_NONE=y
CONFIG_LV_USE_DRAW_SW=y
CONFIG_LV_COLOR_DEPTH_32=y
CONFIG_LV_USE_LABEL=y
CONFIG_LV_USE_IMAGE=y
CONFIG_LV_USE_FLEX=y
CONFIG_LV_USE_SNAPSHOT=y
CONFIG_LV_USE_IMGFONT=y
CONFIG_LV_FONT_FMT_TXT_LARGE=y
CONFIG_LV_USE_BAR=y
CONFIG_LV_USE_THEME_DEFAULT=n
CONFIG_LV_USE_THEME_SIMPLE=n
CONFIG_LV_USE_THEME_MONO=n
CONFIG_LV_MEM_SIZE_KILOBYTES=64
CONFIG_LV_USE_DEMO_WIDGETS=n
CONFIG_LV_USE_DEMO_BENCHMARK=n
CONFIG_LV_USE_DEMO_STRESS=n
CONFIG_LV_USE_DEMO_KEYPAD_AND_ENCODER=n
CONFIG_LV_USE_GIF=n
CONFIG_LV_USE_LODEPNG=n
CONFIG_LV_USE_QRCODE=n
CONFIG_LV_USE_FREETYPE=n
CONFIG_LV_USE_FILE_EXPLORER=n
CONFIG_LV_USE_CALENDAR=n
CONFIG_LV_USE_CHART=n
CONFIG_LV_USE_CALENDAR_HEADER_ARROW=n
CONFIG_LV_USE_CALENDAR_HEADER_DROPDOWN=n
CONFIG_LV_USE_MENU=n
CONFIG_LV_USE_MSGBOX=y
CONFIG_LV_USE_KEYBOARD=n
CONFIG_LV_USE_SPINBOX=n
CONFIG_LV_USE_TABLE=n
CONFIG_LV_USE_TABVIEW=n
CONFIG_LV_USE_TILEVIEW=n
CONFIG_LV_USE_WIN=n
CONFIG_LV_USE_LED=n
CONFIG_LV_USE_LIST=n
CONFIG_LV_USE_DROPDOWN=n
CONFIG_LV_USE_TEXTAREA=n
CONFIG_LV_USE_SPINNER=n
CONFIG_LV_USE_SCALE=n
CONFIG_LV_USE_LOTTIE=n
CONFIG_LV_USE_FFMPEG=n
CONFIG_LV_USE_OBSERVER=n
CONFIG_LV_BUILD_EXAMPLES=n
CONFIG_LV_BUILD_DEMOS=n
CONFIG_LV_FONT_DEFAULT_MONTSERRAT_20=n
CONFIG_LV_USE_LOG=y
CONFIG_LV_LOG_LEVEL_WARN=y

CONFIG_ESP_WIFI_TASK_PINNED_TO_CORE_0=y
CONFIG_ESP_WIFI_TASK_PINNED_TO_CORE_1=n

CONFIG_BOARD_TYPE_ESP_BOX_3=y

# USB camera: use usb_stream component (replaces esp_video UVC driver)
CONFIG_USE_USB_STREAM=y
# Prefer MJPG format (30-80KB/frame) to reduce data size
CONFIG_XIAOZHI_CAMERA_ALLOW_JPEG_INPUT=y
# USB Host HW buffer bias towards IN (required by usb_stream for isochronous IN)
CONFIG_USB_HOST_HW_BUFFER_BIAS_IN=y
# USB Host control transfer buffer
CONFIG_USB_HOST_CONTROL_TRANSFER_MAX_SIZE=1536
# CONFIG_USB_STREAM_QUICK_START is not set
CONFIG_UVC_GET_DEVICE_DESC=y
CONFIG_UVC_GET_CONFIG_DESC=y
CONFIG_UVC_PRINT_DESC=y
# Keep USB/UVC on core 1 above app/media helpers. Audio input is pinned to
# core 0, so camera streaming and microphone capture do not fight on one core.
CONFIG_USB_PROC_TASK_PRIORITY=18
CONFIG_USB_PROC_TASK_CORE=1
CONFIG_SAMPLE_PROC_TASK_PRIORITY=17
CONFIG_SAMPLE_PROC_TASK_CORE=1
```
