## main/Kconfig.projbuild
```kconfig
menu "Xiaozhi Assistant"

config TEMPORARY_TEST_OBSERVABILITY
    bool "Enable temporary radar/reminder/proactive test trace"
    default n
    help
        Emits compact TEST_TRACE lines only at radar state transitions and
        reminder/proactive-wake decisions. This is for manual validation and
        intentionally never logs user text, identities, session ids, tokens,
        URLs, or complete payloads. Set to n once validation is complete, or
        remove main/test_observability.* and its call sites.

config OTA_URL
    string "Default OTA URL"
    default "https://api.realecho.cn/xiaozhi/ota/"
    help
        The application will access this URL to check for new firmwares and server address.

choice
    prompt "Flash Assets"
    default FLASH_DEFAULT_ASSETS
    help
        Select the assets to flash.

    config FLASH_NONE_ASSETS
        bool "Do not flash assets"
    config FLASH_DEFAULT_ASSETS
        bool "Flash Default Assets"
    config FLASH_CUSTOM_ASSETS
        bool "Flash Custom Assets"
endchoice

config CUSTOM_ASSETS_FILE
    depends on FLASH_CUSTOM_ASSETS
    string "Custom Assets File"
    default "assets.bin"
    help
        The custom assets file to flash.
        It can be a local file relative to the project directory or a remote url.

config SPINE_OTA_ALLOWED_HOSTS
    string "Spine OTA HTTPS host allowlist (comma-separated)"
    default "cdn.xiaozhi.me,assets.xiaozhi.me,api.realecho.cn"
    help
        Only these HTTPS hosts are accepted for update_spine downloads. IP literals are rejected.

config SPINE_OTA_ALLOWED_ROLE_IDS
    string "Spine OTA allowed role_id list (comma-separated, or *)"
    default "*"
    help
        Optional product restriction on role_id values after signature verification.
        "*" means any format-valid role_id that also passes ES256 signature, SHA-256,
        official HTTPS host allowlist, and min_fw checks. This is NOT accepting
        arbitrary third-party files — authenticity is enforced by crypto + host
        allowlist. A comma list (e.g. "c131_00,fox_01") restricts further. Empty
        string is fail-closed and rejects all roles.

config WALLPAPER_OTA_ALLOWED_HOSTS
    string "Wallpaper OTA HTTPS host allowlist (comma-separated)"
    default "cdn.xiaozhi.me,assets.xiaozhi.me,api.realecho.cn"
    help
        Only these HTTPS hosts are accepted for update_wallpaper downloads. IP literals are rejected.

config WALLPAPER_OTA_ALLOWED_PACK_IDS
    string "Wallpaper OTA allowed pack_id list (comma-separated, or *)"
    default "*"
    help
        Optional product restriction for signed wallpaper packages. Empty string is fail-closed.

choice
    prompt "Default Language"
    default LANGUAGE_ZH_CN
    help
        Select device display language

    config LANGUAGE_ZH_CN
        bool "Chinese"
    config LANGUAGE_ZH_TW
        bool "Chinese Traditional"
    config LANGUAGE_EN_US
        bool "English"
    config LANGUAGE_JA_JP
        bool "Japanese"
    config LANGUAGE_KO_KR
        bool "Korean"
    config LANGUAGE_VI_VN
        bool "Vietnamese"
    config LANGUAGE_TH_TH
        bool "Thai"
    config LANGUAGE_DE_DE
        bool "German"
    config LANGUAGE_FR_FR
        bool "French"
    config LANGUAGE_ES_ES
        bool "Spanish"
    config LANGUAGE_IT_IT
        bool "Italian"
    config LANGUAGE_RU_RU
        bool "Russian"
    config LANGUAGE_AR_SA
        bool "Arabic"
    config LANGUAGE_HI_IN
        bool "Hindi"
    config LANGUAGE_PT_PT
        bool "Portuguese"
    config LANGUAGE_PL_PL
        bool "Polish"
    config LANGUAGE_CS_CZ
        bool "Czech"
    config LANGUAGE_FI_FI
        bool "Finnish"
    config LANGUAGE_TR_TR
        bool "Turkish"
    config LANGUAGE_ID_ID
        bool "Indonesian"
    config LANGUAGE_UK_UA
        bool "Ukrainian"
    config LANGUAGE_RO_RO
        bool "Romanian"
    config LANGUAGE_BG_BG
        bool "Bulgarian"
    config LANGUAGE_CA_ES
        bool "Catalan"
    config LANGUAGE_DA_DK
        bool "Danish"
    config LANGUAGE_EL_GR
        bool "Greek"
    config LANGUAGE_FA_IR
        bool "Persian"
    config LANGUAGE_FIL_PH
        bool "Filipino"
    config LANGUAGE_HE_IL
        bool "Hebrew"
    config LANGUAGE_HR_HR
        bool "Croatian"
    config LANGUAGE_HU_HU
        bool "Hungarian"
    config LANGUAGE_MS_MY
        bool "Malay"
    config LANGUAGE_NB_NO
        bool "Norwegian"
    config LANGUAGE_NL_NL
        bool "Dutch"
    config LANGUAGE_SK_SK
        bool "Slovak"
    config LANGUAGE_SL_SI
        bool "Slovenian"
    config LANGUAGE_SV_SE
        bool "Swedish"
    config LANGUAGE_SR_RS
        bool "Serbian"
endchoice

choice BOARD_TYPE
    prompt "Board Type"
    default BOARD_TYPE_ESP_BOX_3
    help
        Board type (simplified: ESP-BOX-3 only)
    config BOARD_TYPE_ESP_BOX_3
        bool "Espressif ESP-BOX-3"
        depends on IDF_TARGET_ESP32S3
endchoice

choice WAKE_WORD_TYPE
    prompt "Wake Word Implementation Type"
    default USE_AFE_WAKE_WORD if (IDF_TARGET_ESP32S3 || IDF_TARGET_ESP32P4) && SPIRAM
    default WAKE_WORD_DISABLED
    help
        Choose the type of wake word implementation to use

    config WAKE_WORD_DISABLED
        bool "Disabled"
        help
            Disable wake word detection

    config USE_ESP_WAKE_WORD
        bool "Wakenet model without AFE"
        depends on IDF_TARGET_ESP32C3 || IDF_TARGET_ESP32C5 || IDF_TARGET_ESP32C6 || (IDF_TARGET_ESP32 && SPIRAM)
        help
            Support ESP32 C3、ESP32 C5 与 ESP32 C6, and (ESP32 with PSRAM)

    config USE_AFE_WAKE_WORD
        bool "Wakenet model with AFE"
        depends on (IDF_TARGET_ESP32S3 || IDF_TARGET_ESP32P4) && SPIRAM
        help
            Support AEC if available, requires ESP32 S3 and PSRAM

    config USE_CUSTOM_WAKE_WORD
        bool "Multinet model (Custom Wake Word)"
        depends on (IDF_TARGET_ESP32S3 || IDF_TARGET_ESP32P4) && SPIRAM
        help
            Requires ESP32 S3 and PSRAM

endchoice

config CUSTOM_WAKE_WORD
    string "Custom Wake Word"
    default "ni hao xiao nian"
    depends on USE_CUSTOM_WAKE_WORD
    help
        Custom Wake Word, use pinyin for Chinese, separated by spaces

config CUSTOM_WAKE_WORD_DISPLAY
    string "Custom Wake Word Display"
    default "你好，小念"
    depends on USE_CUSTOM_WAKE_WORD
    help
        Greeting sent to the server after wake word detection

config CUSTOM_WAKE_WORD_THRESHOLD
    int "Custom Wake Word Threshold (%)"
    default 20
    range 1 99
    depends on USE_CUSTOM_WAKE_WORD
    help
        Custom Wake Word Threshold, range 1-99, the smaller the more sensitive, default 20

config SEND_WAKE_WORD_DATA
    bool "Send Wake Word Data"
    default y
    depends on USE_AFE_WAKE_WORD || USE_CUSTOM_WAKE_WORD
    help
        Send wake word data to the server as the first message of the conversation and wait for response

config USE_AUDIO_PROCESSOR
    bool "Enable Audio Noise Reduction"
    default y
    depends on (IDF_TARGET_ESP32S3 || IDF_TARGET_ESP32P4) && SPIRAM
    help
        Requires ESP32 S3 and PSRAM

config USE_DEVICE_AEC
    bool "Enable Device-Side AEC"
    default n
        depends on USE_AUDIO_PROCESSOR && BOARD_TYPE_ESP_BOX_3
    help
        To work properly, device-side AEC requires a clean output reference path from the speaker signal and physical acoustic isolation between the microphone and speaker.

config USE_SERVER_AEC
    bool "Enable Server-Side AEC (Unstable)"
    default n
    depends on USE_AUDIO_PROCESSOR
    help
        To work perperly, server-side AEC requires server support

choice WAKENET_DET_MODE
    prompt "WakeNet detection mode"
    default WAKENET_DET_MODE_AGGRESSIVE
    depends on USE_AFE_WAKE_WORD
    help
        WakeNet detection operating point.

        Aggressive (DET_MODE_95) raises the probability that a wake word is
        detected, which helps long-distance / quiet speech, at the cost of a
        higher false-wake rate. Normal (DET_MODE_90) is more conservative.
        This must not silently depend on the library default.

    config WAKENET_DET_MODE_NORMAL
        bool "Normal (DET_MODE_90)"
    config WAKENET_DET_MODE_AGGRESSIVE
        bool "Aggressive (DET_MODE_95)"
endchoice

config WS_AUDIO_SEND_TIMEOUT_MS
    int "WebSocket audio send timeout (ms)"
    default 500
    range 100 1000
    help
        Per-frame blocking timeout for WebSocket audio binary sends. 300ms can
        be too tight under Wi-Fi jitter and 1000ms risks re-blocking the main
        event loop, so 500ms is the default. On timeout the send is treated as
        a failure and the connection enters the existing recovery path instead
        of stalling for seconds.

config TASK_DIAGNOSTICS_PERIODIC
    bool "Periodic CPU, heap and task snapshots"
    default n
    help
        Print detailed task/CPU/heap snapshots every 15 seconds for debugging.
        Disabled for normal use. Allocation failure reporting remains enabled.

config AUDIO_WAKE_DIAGNOSTICS
    bool "Wake audio diagnostics (rate-limited)"
    default n
    help
        When enabled, AudioService prints a rate-limited INFO line
        [AUDIO_WAKE_DIAG] (at most once per second) while idle and WakeNet is
        running, reporting mic/reference average and peak levels, input gain,
        input format, AEC status, and audio read/frame-drop/AFE error counters.
        No PCM or raw audio is logged or transmitted. Disabled by default.

config TOUCH_DIAGNOSTICS
    bool "Touch diagnostics (event-level)"
    default n
    help
        When enabled, TouchManager and GestureEngine print event-level
        diagnostics: stable press/release transitions (raw + normalized
        coordinates, debounce sample counts, I2C fail count) and the final
        recognized gesture. It never logs per-10ms samples. Disabled by
        default; use only during field calibration of the touch debounce and
        threshold.

config TOUCH_FT6336_THGROUP
    int "FT6336U touch threshold (THGROUP, register 0x80)"
    default 22
    range 1 255
    help
        FT6336U touch detection threshold. Smaller values are more sensitive.
        The default keeps the current 22; if field testing shows false touches
        (e.g. spurious HEAD TAP interrupting playback), raise it step by step
        (for example 30, 40, ...). Do not raise it without field evidence.

config OPUS_STACK_SIZE
    int "Opus codec task stack size (bytes)"
    default 16384
    range 4096 32768
    help
        Stack size for Opus encode/decode task. Increase if TTS audio causes stack overflow.

config AUDIO_READY_TIMEOUT_MS
    int "Audio subsystem ready timeout (ms)"
    default 3000
    range 500 10000
    help
        Maximum time to wait for the audio processor (VAD/ASR) to become ready
        after entering Listening state. If exceeded, the system enters DEGRADED
        mode and passes audio through without buffering.

config AUDIO_PREBUFFER_FRAMES
    int "Audio pre-buffer frames when not ready"
    default 50
    range 5 200
    help
        Maximum number of audio frames to buffer while the audio processor
        is warming up. Older frames are discarded when the buffer is full.

config AUDIO_NOT_READY_LOG_INTERVAL_MS
    int "Audio not-ready log interval (ms)"
    default 2000
    range 500 10000
    help
        Minimum interval between repeated "audio not ready" log messages
        to prevent log flooding during initialization.

config USE_AUDIO_DEBUGGER
    bool "Enable Audio Debugger"
    default n
    help
        Enable audio debugger, send audio data through UDP to the host machine

config AUDIO_DEBUG_UDP_SERVER
    string "Audio Debug UDP Server Address"
    default "192.168.2.100:8000"
    depends on USE_AUDIO_DEBUGGER
    help
        UDP server address, format: IP:PORT, used to receive audio debugging data

config USE_ACOUSTIC_WIFI_PROVISIONING
    bool "Enable Acoustic WiFi Provisioning"
    default n
    help
        Enable acoustic WiFi provisioning, use audio signal to transmit WiFi configuration data

config RECEIVE_CUSTOM_MESSAGE
    bool "Enable Custom Message Reception"
    default n
    help
        Enable custom message reception, allow the device to receive custom messages from the server (preferably through the MQTT protocol)

menu "Camera Configuration"
    depends on !IDF_TARGET_ESP32

    config USE_USB_STREAM
        bool "Use usb_stream component for USB UVC camera"
        default n
        depends on IDF_TARGET_ESP32S3
        help
            Use the usb_stream component (from ESP-IoT-Solution) instead of esp_video
            to drive the USB UVC camera.

    comment "Warning: Please read the help text before modifying these settings."
    
    config XIAOZHI_CAMERA_ALLOW_JPEG_INPUT
        bool "Allow JPEG Input"
        default n
        help
            Allow JPEG Input format for the camera.

            This option may need to be enabled when using a USB camera.

            Not currently supported when used simultaneously with XIAOZHI_ENABLE_ROTATE_CAMERA_IMAGE.

    config XIAOZHI_ENABLE_HARDWARE_JPEG_ENCODER
        bool "Enable Hardware JPEG Encoder"
        default y
        depends on SOC_JPEG_ENCODE_SUPPORTED
        help
            Use hardware JPEG encoder on ESP32-P4 to encode image to JPEG.
            See https://docs.espressif.com/projects/esp-idf/en/stable/esp32p4/api-reference/peripherals/jpeg.html for more details.

    config XIAOZHI_ENABLE_HARDWARE_JPEG_DECODER
        bool "Enable Hardware JPEG Decoder"
        default n
        depends on SOC_JPEG_DECODE_SUPPORTED && XIAOZHI_CAMERA_ALLOW_JPEG_INPUT
        help
            Use hardware JPEG decoder on ESP32-P4 to decode JPEG to image.
            See https://docs.espressif.com/projects/esp-idf/en/stable/esp32p4/api-reference/peripherals/jpeg.html for more details.

    config XIAOZHI_ENABLE_CAMERA_DEBUG_MODE
        bool "Enable Camera Debug Mode"
        default n
        help
            Enable camera debug mode, print camera debug information to the console.
            Only works on boards that support camera.

    config XIAOZHI_ENABLE_CAMERA_ENDIANNESS_SWAP
        bool "Enable software camera buffer endianness swapping"
        default n
        depends on !CAMERA_SENSOR_SWAP_PIXEL_BYTE_ORDER
        help
            This option treats the camera buffer as a uint16_t[] array and performs byte-swapping (endianness conversion) on each element.

            Should only be modified by development board integration engineers.

            **Incorrect usage may result in incorrect image colors!**

            ATTENTION: If the option CAMERA_SENSOR_SWAP_PIXEL_BYTE_ORDER is available for your sensor, please use that instead.

    menuconfig XIAOZHI_ENABLE_ROTATE_CAMERA_IMAGE
        bool "Enable Camera Image Rotation"
        default n
        depends on !XIAOZHI_CAMERA_ALLOW_JPEG_INPUT
        help
            Enable camera image rotation, rotate the camera image to the correct orientation.
            - On ESP32-P4, rotation is handled by PPA hardware.
            - On other chips, rotation is done in software with performance cost.
            - For 180° rotation, use HFlip + VFlip instead of this option.

            Not currently supported when used simultaneously with XIAOZHI_CAMERA_ALLOW_JPEG_INPUT.

    if XIAOZHI_ENABLE_ROTATE_CAMERA_IMAGE
        choice XIAOZHI_CAMERA_IMAGE_ROTATION_ANGLE
            prompt "Camera Image Rotation Angle (clockwise)"
            default XIAOZHI_CAMERA_IMAGE_ROTATION_ANGLE_90
            help
                Camera image rotation angle.
            config XIAOZHI_CAMERA_IMAGE_ROTATION_ANGLE_90
                bool "90°"
            config XIAOZHI_CAMERA_IMAGE_ROTATION_ANGLE_270
                bool "270°"
            comment "For 180° rotation, use HFlip + VFlip instead of this option"
        endchoice
    endif
endmenu

endmenu

menu "Realecho Dev Endpoint"

config REALECHO_OTA_TLS_DIAG
    bool "Dev: OTA TLS structured diagnostics ([OTA_TLS])"
    default n
    help
        Log attempt id, heap, Wi-Fi RSSI, task stack and official esp_tls
        error codes during OTA bootstrap. Never logs tokens or response bodies.

config REALECHO_OTA_TLS_PROBE
    bool "Dev: pure TLS probe before each OTA CheckVersion"
    depends on REALECHO_OTA_TLS_DIAG
    default n
    help
        Diagnostic only. Before each OTA HTTP attempt, open a serial esp_tls
        connection to api.realecho.cn:443 with the same certificate bundle,
        then close. This creates an EXTRA TLS connection ahead of the real
        OTA request and can interfere with handshake/RST investigations.
        Keep disabled for normal testing and release builds.
        Code under #if CONFIG_REALECHO_OTA_TLS_PROBE may remain in the tree
        for manual enablement; do not turn this on in production overlays.

endmenu
```
